## package/rilp-kernel/Config.in
```kconfig
config BR2_PACKAGE_RILP_KERNEL
    bool "rilp-kernel"
    depends on BR2_LINUX_KERNEL
    help
      RILP kernel module for deadline-to-priority mapping.
      Reads deadline_us from RILP messages and maps to SCHED_FIFO priority.
```

## package/roboos-hal/Config.in
```kconfig
config BR2_PACKAGE_ROBOOS_HAL
    bool "roboos-hal"
    help
      RoboOS Hardware Abstraction Layer for PiCar-X.
      Provides motor control via I2C to the Robot HAT.
```
